## include/soc/oplus/Kconfig
```kconfig
#ifdef OPLUS_FEATURE_HEALTHINFO
config OPPO_HEALTHINFO
bool "config oppo healthinfo"
help
    define this config to init oppo healthinfo.
config CAMERA_OPT
	bool "config camera opt"
	default n
	help
	  reduce camera provider task runnable time
config MMAP_LOCK_OPT
	bool "config mmap lock opt boos"
	default n
	help
	  reduce sleep time in mmap lock
#endif /* OPLUS_FEATURE_HEALTHINFO */

# SPDX-License-Identifier: GPL-2.0-only
# Copyright (C) 2018-2020 Oplus. All rights reserved.

config OPLUS_FEATURE_LOWMEM_DBG
        bool "OPLUS Low Memory debug"
        default n
        help
          print memory usage when low mem occurs.
```
